## CMakeLists.txt
```
# SPDX-License-Identifier: Apache-2.0

cmake_minimum_required(VERSION 3.20.0)

find_package(Zephyr)
project(some_app LANGUAGES C CXX ASM)

target_include_directories(app PRIVATE
	${CMAKE_CURRENT_SOURCE_DIR}/inc
	${CMAKE_CURRENT_SOURCE_DIR}/src
)

file(GLOB app_sources src/*.cpp)
target_sources(app PRIVATE ${app_sources})
```

## prj.conf
```kconfig
CONFIG_CPLUSPLUS=y
CONFIG_STD_CPP17=y
```

## src/main.cpp
```c
#include <zephyr/zephyr.h>
#include "math.hpp"

void main() {
	printk("Hello! 6 + 4 = %d\n", math::add(6,4));
}
```

## inc/math.hpp
```c
#ifndef APP_ZTEST_INC_MATH_HPP
#define APP_ZTEST_INC_MATH_HPP

#include <stdint.h>

namespace math {

uint32_t add(uint32_t op1, uint32_t op2);
uint32_t subtract(uint32_t op1, uint32_t op2);
uint32_t multiply(uint32_t op1, uint32_t op2);
uint32_t divide(uint32_t op1, uint32_t op2);
uint32_t modulate(uint32_t op1, uint32_t op2);

uint32_t power(uint32_t op1, uint32_t op2);
uint32_t factorial(uint32_t op);

}


#endif
```

## inc/mock.hpp
```c
#ifndef APP_ZTEST_INC_MOCK_HPP
#define APP_ZTEST_INC_MOCK_HPP

#include <stdint.h>

namespace mocks {

bool write(uint32_t val);
bool read(uint32_t *val);

}


#endif
```

## src/math.cpp
```c
#include "math.hpp"

namespace math {

uint32_t add(uint32_t op1, uint32_t op2) {
	return op1 + op2;
}

uint32_t subtract(uint32_t op1, uint32_t op2) {
	return op1 - op2;
}

uint32_t multiply(uint32_t op1, uint32_t op2) {
	return op1 * op2;
}

uint32_t divide(uint32_t op1, uint32_t op2) {
	return op1 / op2;
}

uint32_t modulate(uint32_t op1, uint32_t op2) {
	return op1 % op2;
}

uint32_t power(uint32_t op1, uint32_t op2) {
	uint32_t val = 1;
	op2++;
	while (--op2) {
		val *= op1;
	}
	return val;
}

uint32_t factorial(uint32_t op) {
	return (op == 0 || op == 1) ? 1 : op * factorial(op-1);
}

}
```
