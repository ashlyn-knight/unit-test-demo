## CMakeLists.txt
```
# SPDX-License-Identifier: Apache-2.0

cmake_minimum_required(VERSION 3.20.0)
find_package(Zephyr)
project(ztest LANGUAGES C CXX ASM)

target_include_directories(app PRIVATE
	src
	../inc
	../src
)

file(GLOB test_sources
	${CMAKE_CURRENT_SOURCE_DIR}/../src/*.cpp
	${CMAKE_CURRENT_SOURCE_DIR}/src/*.cpp
)

list(REMOVE_ITEM test_sources ${CMAKE_CURRENT_SOURCE_DIR}/../src/main.cpp)

target_sources(app PRIVATE ${test_sources})
```

## prj.conf
```kconfig
CONFIG_CPLUSPLUS=y
CONFIG_STD_CPP17=y

CONFIG_ZTEST=y
CONFIG_ZTEST_NEW_API=y
CONFIG_ZTEST_ASSERT_VERBOSE=2
```

## src/test_assert.cpp
```c
#include <ztest.h>

ZTEST_SUITE(base, NULL, NULL, NULL, NULL, NULL);

ZTEST(base, test_assert) {
	zassert_true(true, "1 was false");
	zassert_false(false, "0 was true");
	zassert_is_null(NULL, "NULL was not NULL");
	zassert_not_null("foo", "\"foo\" was NULL");
	zassert_equal(1, 1, "1 was not equal to 1");
	zassert_equal_ptr(NULL, NULL, "NULL was not equal to NULL");
}
```

## src/test_math.cpp
```c
#include <ztest.h>

#include "math.hpp"

ZTEST_SUITE(math, NULL, NULL, NULL, NULL, NULL);

ZTEST(math, test_add) {
	zassert_equal(math::add(0,0), 0, "0+0 != 0");
	zassert_equal(math::add(1,0), 1, "1+0 != 1");
	zassert_equal(math::add(1,1), 2, "1+1 != 2");
	zassert_equal(math::add(2,8), 10, "2+8 != 10");
	zassert_equal(math::add(8,2), 10, "8+2 != 10");
}

ZTEST(math, test_subtract) {
	zassert_equal(math::subtract(0,0), 0, "0-0 != 0");
	zassert_equal(math::subtract(1,0), 1, "1-0 != 1");
	zassert_equal(math::subtract(1,1), 0, "1-1 != 0");
	zassert_equal(math::subtract(8,2), 6, "8-2 != 6");
}

ZTEST(math, test_multiply) {
	zassert_equal(math::multiply(0,0), 0, "0*0 != 0");
	zassert_equal(math::multiply(1,0), 0, "1*0 != 0");
	zassert_equal(math::multiply(1,1), 1, "1*1 != 1");
	zassert_equal(math::multiply(8,2), 16, "8*2 != 16");
	zassert_equal(math::multiply(2,8), 16, "2*8 != 16");
}

ZTEST(math, test_divide) {
	zassert_equal(math::divide(0,1), 0, "0/1 != 0");
	zassert_equal(math::divide(1,1), 1, "1/1 != 1");
	zassert_equal(math::divide(8,2), 4, "8/2 != 4");
	zassert_equal(math::divide(9,2), 4, "9/2 != 4");
}

ZTEST(math, test_modulate) {
	zassert_equal(math::modulate(0,1), 0, "0%1 != 0");
	zassert_equal(math::modulate(1,1), 0, "1%1 != 0");
	zassert_equal(math::modulate(8,2), 0, "8%2 != 0");
	zassert_equal(math::modulate(9,2), 1, "9%2 != 1");
}

ZTEST(math, test_power) {
	zassert_equal(math::power(0,1), 0, "0^1 != 0");
	zassert_equal(math::power(1,0), 1, "1^0 != 1");
	zassert_equal(math::power(3,0), 1, "3^0 != 1");
	zassert_equal(math::power(3,1), 3, "3^1 != 3");
	zassert_equal(math::power(3,3), 27, "3^3 != 27");
}

ZTEST(math, test_factorial) {
	zassert_equal(math::factorial(0), 1, "0! != 1");
	zassert_equal(math::factorial(1), 1, "1! != 1");
	zassert_equal(math::factorial(2), 2, "2! != 2");
	zassert_equal(math::factorial(3), 6, "3! != 6");
	zassert_equal(math::factorial(8), 40320, "8! != 40320");
}
```

## src/test_mock.cpp
```c
#include <ztest.h>

#include "mock.hpp"

ZTEST_SUITE(mock, NULL, NULL, NULL, NULL, NULL);

ZTEST(mock, test_stuff) {
	uint32_t data = 0;
	zassert_false(mocks::read(&data), "data to read");
	zassert_true(mocks::write(12), "data already written");
	zassert_false(mocks::write(14), "data overwritten");
	zassert_true(mocks::read(&data), "data can't be read");
	zassert_equal(data, 12, "data incorrect");
	zassert_false(mocks::read(&data), "data to read");
}
```
